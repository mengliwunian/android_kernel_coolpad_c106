## drivers/input/fingerprint/Kconfig
```kconfig
source "drivers/input/fingerprint/goodix/Kconfig"
source "drivers/input/fingerprint/fpc_linux/Kconfig"
```

## drivers/staging/product_config/Kconfig
```kconfig
config PRODUCT_C1
	bool "Enable yulong c1 product configs"
	default n
	help
	  Enable yulong c1 product configs
```
